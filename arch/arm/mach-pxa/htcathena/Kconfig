## arch/arm/mach-pxa/htcathena/Kconfig
```kconfig
menuconfig MACH_HTCATHENA
	bool "HTC Athena"
	select PXA27x
	select PXA_SSP
	select BOARD_IRQ_MAP_BIG
	select HTC_EGPIO
	select ADC
	select ADC_AD7877
	select TOUCHSCREEN_ADC
	select HTCATHENA_VSFB
	select HTCATHENA_SOUND
	select MMC_ATIW
	select KEYBOARD_GPIO
	#select HTCATHENA_DPRAM
	#select HTCATHENA_PHONE
	help
		Say Y here if you intend to run this kernel on a
		HTC Athena. Currently there is only basic support
		for this phone.

config HTCATHENA_VSFB
	tristate "HTC Athena VSFB LCD support /w Page Flipping"
	depends on FB && MACH_HTCATHENA && LCD_CLASS_DEVICE
	select FB_CFB_FILLRECT
	select FB_CFB_COPYAREA
	select FB_CFB_IMAGEBLIT
	---help---
	  This driver provides primitive support for HTC Athena LCD display and also adds Page Flipping support.

config HTCATHENA_SOUND
	tristate "HTC Athena Audio driver"
	depends on (MACH_HTCATHENA || MACH_HTCUNIVERSAL) && SND && I2C
	#select SND_AK4641
	help
	  Say Y or M if you have a HTC Universal/Athena or other supported device and want audio support

config HTCATHENA_DPRAM
	tristate "HTC Athena DPRAM driver"
	depends on MACH_HTCATHENA
	select SERIAL_CORE
	help
	  Experimental driver for the Athena's MSM6275 chipset via DPRAM.

config HTCATHENA_PHONE
	tristate "HTC Athena Phone driver"
	depends on (MACH_HTCATHENA && HTCATHENA_DPRAM)
	help
	  Experimental driver for the Athena's Phone/Modem.

#config HTCATHENA_BLUETOOTH
#	tristate "HTC Athena Bluetooth"
#	depends on MACH_HTCATHENA && HTC_EGPIO
#	help
#	  Enables support for the TI BRF6150 Bluetooth Module
#	  in HTC Athena.

#config HTCATHENA_GPS
#	tristate "HTC Athena GPS"
#	depends on MACH_HTCATHENA && HTC_EGPIO
#	help
#	  Enables support for the SiRF-3 GPS Module
#	  in HTC Athena.
```

## drivers/android/Kconfig
```kconfig
menu "Android"

config ANDROID_BINDER_IPC
	tristate "Binder IPC Driver"
	default y

config ANDROID_POWER
	bool "Android power driver"
	depends on PM && RTC_CLASS
	default n

config ANDROID_POWER_STAT
	bool "Android power driver lock stats"
	depends on ANDROID_POWER
	default y

config ANDROID_LOGGER
	bool "Android log driver"
	default y

config ANDROID_RAM_CONSOLE
	bool "RAM buffer console"
	default n

config ANDROID_RAM_CONSOLE_ENABLE_VERBOSE
	bool "Enable verbose console messages"
	default y
	depends on ANDROID_RAM_CONSOLE

config ANDROID_RAM_CONSOLE_ERROR_CORRECTION
	bool "Enable error correction"
	default n
	select REED_SOLOMON
	select REED_SOLOMON_ENC8
	select REED_SOLOMON_DEC8

config ANDROID_RAM_CONSOLE_EARLY_INIT
	bool "Start ram console early"
	default n
	depends on ANDROID_RAM_CONSOLE

config ANDROID_RAM_CONSOLE_EARLY_ADDR
	hex "RAM console virtual address"
	default 0
	depends on ANDROID_RAM_CONSOLE_EARLY_INIT

config ANDROID_RAM_CONSOLE_EARLY_SIZE
	hex "RAM console buffer size"
	default 0
	depends on ANDROID_RAM_CONSOLE_EARLY_INIT

config ANDROID_TIMED_GPIO
	bool "Android timed gpio driver"
	depends on GENERIC_GPIO
	default y

endmenu
```
